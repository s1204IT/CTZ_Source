## kernel-4.14/drivers/input/touchscreen/mediatek/Kconfig
```kconfig
#
# Touchscreen driver configuration
#
menuconfig INPUT_TOUCHSCREEN
	bool "Touchscreens"
	help
	  Say Y here, and a list of supported touchscreens will be displayed.
	  This option doesn't affect the kernel.

	  If unsure, say Y.

if INPUT_TOUCHSCREEN

config TOUCHSCREEN_MTK
	bool "MediaTek Touch Panel Driver"
	help
	  Say Y here if you have MediaTek touch panel.

	  If unsure, say N.

	  To compile this dirver as a module, choose M here: the
	  module will be called.

config TOUCHSCREEN_PHYSICAL_ROTATION_WITH_LCM
	bool "MediaTek Touch Panel Rotation With LCM"
	default y
	help
	  Say N here if touch panel is not physical rotated as LCM does.
	  Physically rotated means that this driver will map
	  the reported coordination to diagonal position.

	  If unsure, say Y.
config TOUCHSCREEN_MTK_SOLOMON
	bool "SOLOMON for Mediatek package"
	default n
	help
	  Say Y here if you have SOLOMON touch panel.

	  If unsure, say N.

	  To compile this dirver as a module, choose M here: the
	  module will be called.


config TOUCHSCREEN_MTK_FOCALTECH_TS
	bool "FOCALTECH_TS for Mediatek package"
	default n
	help
	  Say Y here if you have focaltech_touch touch panel.

	  If unsure, say N.

	  To compile this dirver as a module, choose M here: the
	  module will be called.


config TOUCHSCREEN_MTK_GT1151
	bool "GT1151 for Mediatek package"
	default n
	help
	  Say Y here if you have GT1151 touch panel.

	  If unsure, say N.

	  To compile this dirver as a module, choose M here: the
	  module will be called.

source "drivers/input/touchscreen/mediatek/GT1151/Kconfig"

config TOUCHSCREEN_MTK_GT911
	bool "GT911 for Mediatek package"
	help
	  Say Y here if you have GT911 touch panel.

	  If unsure, say N.
	  this is a GT911 touch driver config, you can use it
	  if you want.

source "drivers/input/touchscreen/mediatek/GT911/Kconfig"

config TOUCHSCREEN_MTK_GT9110
	bool "GT9110 for Mediatek package"
	help
	  Say Y here if you have GT9110 touch panel.

	  If unsure, say N.

	  To compile this dirver as a module, choose M here: the
	  module will be called.

source "drivers/input/touchscreen/mediatek/GT9110/Kconfig"

config TOUCHSCREEN_MTK_NT36xxx
	bool "NT36xxx for Mediatek package"
	default n
	help
	  Say Y here if you have NT36xxx touch panel.

	  If unsure, say N.

	  To compile this dirver as a module, choose M here: the
	  module will be called.

config TOUCHSCREEN_MTK_GT917
	bool "GT917 for Mediatek package"
	help
	  Say Y here if you have GT917 touch panel.

	  If unsure, say N.

source "drivers/input/touchscreen/mediatek/GT917/Kconfig"

config TOUCHSCREEN_MTK_WACOM
	tristate "WACOM Touchscreen"
	help
	  Say Y here if you have WACOM touchscreen,
	  connected to your system.
	  If unsure, say N.
	  To compile this driver as a module, choose M here.

config TOUCHSCREEN_MTK_WACOM_DIGI
	tristate "WACOM Digi"
	help
	  Say Y here if you have WACOM digi,
	  connected to your system.
	  If unsure, say N.
	  To compile this driver as a module, choose M here.

config TOUCHSCREEN_NT36XXX
	bool "Novatek NT36XXX"
	help
	  Say Y here if you have a Novatek NT36xxx touchscreen connected
	  to your system.

	  If unsure, say N.

endif
```

## kernel-4.14/drivers/misc/mediatek/edmc/Kconfig
```kconfig
config MTK_EDMC_SUPPORT
	bool "EDMC (External DMA) Driver"
	default n
	help
	  The purpose of Mediatek eDMC is performing
	  data transfer between external memory such as
	  DRAM/TCM, It will cooperate with MDLA. eDMC
	  support different modes for image process.
```

## kernel-4.14/drivers/misc/mediatek/mtee/Kconfig
```kconfig
config MTK_IN_HOUSE_TEE_SUPPORT
	bool "Enable MTK In House TEE Support"
	help
	  This option decides if the support MTK in-house TEE
	  (Trusted Execution Environment)
	  Set to yes if MTK TEE is supported.
	  If you are not sure if it is supported, set it to no.

config MTK_DRM_KEY_MNG_SUPPORT
	bool "Enable MTK DRM Key Manager Support"
	depends on (MTK_IN_HOUSE_TEE_SUPPORT) || (TRUSTONIC_TEE_SUPPORT) || (TRUSTY)
	help
	  This enable MTK DRM Key Manager Support.
	  depending on MTK In-House TEE Support
	  or Trustonic TEE Support
```

## kernel-4.14/drivers/misc/mediatek/scp/Kconfig
```kconfig
config MTK_TINYSYS_SCP_SUPPORT
	bool "Specify Interface Support SCP"
	default n
	help
	  SCP is a MediaTek in-house DSP which can receive
	  command from IPI interface.
	  Set Y to enable this feature.
	  If unsure,
	  Set N to stay with legancy feature.

config MTK_TINYSYS_CLK_SUPPORT
	bool "Specific clk interface support for tinysys"
	default n
	help
	  Tinysys is a small OS that run on individual CPU.
	  This feature is to provide clk consumer control driver which
	  supports basic operations.
	  Set Y to enable this feature.
	  If unsure,
	  set N to stay with legancy feature.

config MTK_TINYSYS_SUSPEND_SUPPORT
	bool "clk suspend support"
	depends on MTK_TINYSYS_CLK_SUPPORT && HAVE_ARM_SMCCC
	default n
	help
	  Tinysys is a small OS that run on individual CPU.
	  This feature is to support suspend/resume operations in tinysys.
	  Note this feature also needs SMC handler support.
	  Set Y to enable this feature.
	  If unsure,
	  set N to stay with legancy feature.
```
